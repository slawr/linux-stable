## arch/arm/mach-shmobile/Kconfig
```kconfig
if ARCH_SHMOBILE

comment "SH-Mobile System Type"

config ARCH_SH7367
	bool "SH-Mobile G3 (SH7367)"
	select CPU_V6
	select SH_CLK_CPG
	select ARCH_WANT_OPTIONAL_GPIOLIB

config ARCH_SH7377
	bool "SH-Mobile G4 (SH7377)"
	select CPU_V7
	select SH_CLK_CPG
	select ARCH_WANT_OPTIONAL_GPIOLIB

config ARCH_SH7372
	bool "SH-Mobile AP4 (SH7372)"
	select CPU_V7
	select SH_CLK_CPG
	select ARCH_WANT_OPTIONAL_GPIOLIB

config ARCH_SH73A0
	bool "SH-Mobile AG5 (R8A73A00)"
	select CPU_V7
	select SH_CLK_CPG
	select ARCH_WANT_OPTIONAL_GPIOLIB
	select ARM_GIC
	select I2C

config ARCH_R8A7740
	bool "R-Mobile A1 (R8A77400)"
	select CPU_V7
	select SH_CLK_CPG
	select ARCH_WANT_OPTIONAL_GPIOLIB

config ARCH_R8A7779
	bool "R-Car H1 (R8A77790)"
	select CPU_V7
	select SH_CLK_CPG
	select ARM_GIC
	select ARCH_WANT_OPTIONAL_GPIOLIB

comment "SH-Mobile Board Type"

config MACH_G3EVM
	bool "G3EVM board"
	depends on ARCH_SH7367
	select ARCH_REQUIRE_GPIOLIB

config MACH_G4EVM
	bool "G4EVM board"
	depends on ARCH_SH7377
	select ARCH_REQUIRE_GPIOLIB

config MACH_AP4EVB
	bool "AP4EVB board"
	depends on ARCH_SH7372
	select ARCH_REQUIRE_GPIOLIB
	select SH_LCD_MIPI_DSI

choice
	prompt "AP4EVB LCD panel selection"
	default AP4EVB_QHD
	depends on MACH_AP4EVB

config AP4EVB_QHD
	bool "MIPI-DSI QHD (960x540)"

config AP4EVB_WVGA
	bool "Parallel WVGA (800x480)"

endchoice

config MACH_AG5EVM
	bool "AG5EVM board"
	select ARCH_REQUIRE_GPIOLIB
	select SH_LCD_MIPI_DSI
	depends on ARCH_SH73A0

config MACH_MACKEREL
	bool "mackerel board"
	depends on ARCH_SH7372
	select ARCH_REQUIRE_GPIOLIB

config MACH_KOTA2
	bool "KOTA2 board"
	select ARCH_REQUIRE_GPIOLIB
	depends on ARCH_SH73A0

config MACH_BONITO
	bool "bonito board"
	select ARCH_REQUIRE_GPIOLIB
	depends on ARCH_R8A7740

config MACH_MARZEN
	bool "MARZEN board"
	depends on ARCH_R8A7779
	select ARCH_REQUIRE_GPIOLIB

choice
	prompt "USB-PHY workaround"
	depends on MACH_MARZEN
	default USB_PHY_MARZEN_010S

	config USB_PHY_MARZEN_010S
	       bool "for Marzen R0P7779A00010S"
	       help
	         Use USB-PHY workaround Marzen board R0P7779A00010S.

	config USB_PHY_MARZEN_110S
	       bool "for Marzen R0P7779A00110S"
	       help
	         Use USB-PHY workaround Marzen board R0P7779A00110S.

endchoice

config MACH_MARZEN_REE_EDC_EXP_BOARD
	bool "Support REE-EDC Marzen Expansion Board"
	depends on MACH_MARZEN
	select VIDEO_TFP410
	help
	  Include support for the REE-EDC Marzen Expansion Board.
	  The expansion board from Renesas Europe adds two HDMI outputs,
	  4 video inputs, on-chip ethernet, and additional serial ports.

config MACH_MARZEN_REE_EDC_EXP_BOARD_ETH
	bool "Use on-chip ethernet instead of >10-bit VIN0"
	depends on MACH_MARZEN_REE_EDC_EXP_BOARD
	help
	  The on-chip ethernet is multiplexed with some video in 0 (VIN0) pins.
	  Note that the expansion board connectors CAM0 to CAM3 do not support
	  >10-bit data widths. Therefore, is possible to use both the on-chip
	  ethernet and four cameras, if you select this option.

config MACH_MARZEN_REE_EDC_EXP_BOARD_DU1
	bool "Use Display Unit 1 instead of VIN2"
	depends on MACH_MARZEN_REE_EDC_EXP_BOARD
	help
	  Display Unit 1 is multiplexed with video in 2 (VIN2).

config MACH_MARZEN_REE_EDC_EXP_BOARD_24BIT_VIN
	bool "Use 24-bit input on VIN0"
	depends on MACH_MARZEN_REE_EDC_EXP_BOARD
	depends on !MACH_MARZEN_REE_EDC_EXP_BOARD_ETH
	select SOC_CAMERA_RGB24BIT
	help
	  This uses 24-bit RGB data on VIN0 with external HSYNC & VSYNC
	  signals.

comment "SH-Mobile System Configuration"

config CPU_HAS_INTEVT
        bool
	default y

menu "Memory configuration"

config MEMORY_START
	hex "Physical memory start address"
	default "0x50000000" if MACH_G3EVM
	default "0x40000000" if MACH_G4EVM || MACH_AP4EVB || MACH_AG5EVM || \
				MACH_MACKEREL || MACH_BONITO
	default "0x41000000" if MACH_KOTA2
	default "0x00000000"
	---help---
	  Tweak this only when porting to a new machine which does not
	  already have a defconfig. Changing it from the known correct
	  value on any of the known systems will only lead to disaster.

config MEMORY_SIZE
	hex "Physical memory size"
	default "0x08000000" if MACH_G3EVM
	default "0x08000000" if MACH_G4EVM
	default "0x20000000" if MACH_AG5EVM || MACH_BONITO
	default "0x1e000000" if MACH_KOTA2
	default "0x10000000" if MACH_AP4EVB || MACH_MACKEREL
	default "0x04000000"
	help
	  This sets the default memory size assumed by your kernel. It can
	  be overridden as normal by the 'mem=' argument on the kernel command
	  line.

endmenu

menu "Timer and clock configuration"

config SHMOBILE_TIMER_HZ
	int "Kernel HZ (jiffies per second)"
	range 32 1024
	default "128"
	help
	  Allows the configuration of the timer frequency. It is customary
	  to have the timer interrupt run at 1000 Hz or 100 Hz, but in the
	  case of low timer frequencies other values may be more suitable.
	  SH-Mobile systems using a 32768 Hz RCLK for clock events may want
	  to select a HZ value such as 128 that can evenly divide RCLK.
	  A HZ value that does not divide evenly may cause timer drift.

config SH_TIMER_CMT
	bool "CMT timer driver"
	default y
	help
	  This enables build of the CMT timer driver.

config SH_TIMER_TMU
	bool "TMU timer driver"
	default y
	help
	  This enables build of the TMU timer driver.

endmenu

config SH_CLK_CPG
	bool

source "drivers/sh/Kconfig"

endif
```

## sound/soc/rcar/Kconfig
```kconfig
menu "SoC Audio support for R-Car"
	depends on ARCH_RCAR || MACH_MARZEN || MACH_HURRICANE

##
## Audio unit modules
##

config SND_SOC_RCAR
	tristate "R-Car H1 sound support"
	select SND_HWDEP
	select SND_RCAR_AK4643 if MACH_MARZEN
	select SND_RCAR_AK4648 if MACH_HURRICANE
	help
	  This option enables R-Car Marzen and Hurricane platform sound support

	  To compile this driver as a module, choose M here: the
	  module will be called snd_soc_rcar.

##
## Boards
##

config SND_RCAR_AK4643
	tristate "R-Car AK4643 sound support"
	depends on SND_SOC_RCAR
	select SND_SOC_AK4642
	help
	  This option enables the sound support for
	  AK4643 unit of R-Car platform.

config SND_SOC_AK4643_RCAR
	bool
	depends on SND_RCAR_AK4643
	default y


config SND_RCAR_AK4648
	tristate "R-Car AK4648 sound support"
	depends on SND_SOC_RCAR
	select SND_SOC_AK4642
	help
	  This option enables the sound support for
	  AK4648 unit of R-Car platform.

config SND_SOC_AK4648_RCAR
	bool
	depends on SND_RCAR_AK4648
	default y

endmenu
```
